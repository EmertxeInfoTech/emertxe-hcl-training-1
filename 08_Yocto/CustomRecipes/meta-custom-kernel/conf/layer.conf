## 08_Yocto/CustomRecipes/meta-custom-kernel/conf/layer.conf
```bitbake
# We have a conf and classes directory, add to BBPATH
BBPATH .= ":${LAYERDIR}"

# We have recipes-* directories, add to BBFILES
BBFILES += "${LAYERDIR}/recipes-*/*/*.bb \
            ${LAYERDIR}/recipes-*/*/*.bbappend"

BBFILE_COLLECTIONS += "meta-custom-kernel"
BBFILE_PATTERN_meta-custom-kernel = "^${LAYERDIR}/"
BBFILE_PRIORITY_meta-custom-kernel = "6"

LAYERDEPENDS_meta-custom-kernel = "core"
LAYERSERIES_COMPAT_meta-custom-kernel = "scarthgap"
```
